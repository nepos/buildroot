## package/casync/Config.in
```kconfig
config BR2_PACKAGE_CASYNC
	bool "casync"
	select BR2_PACKAGE_XZ
	select BR2_PACKAGE_LIBGCRYPT
	help
	  casync — Content Addressable Data Synchronizer

	  https://github.com/systemd/casync
```

## package/nepos-kiosk-browser-qt/Config.in
```kconfig
config BR2_PACKAGE_NEPOS_KIOSK_BROWSER_QT
	bool "Kiosk browser (Qt)"
	depends on BR2_PACKAGE_QT5
	select BR2_PACKAGE_QT5BASE_WIDGETS
	select BR2_PACKAGE_QT5BASE_NETWORK
	select BR2_PACKAGE_QT5BASE_GUI
	select BR2_PACKAGE_QT5WEBCHANNEL
	select BR2_PACKAGE_QT5WEBENGINE
	help
	  Simple kiosk browser based on Qt/QWebEngine

	  https://github.com/nepos/kiosk-browser-qt
```

## package/qt5/qt5quickcontrols2/Config.in
```kconfig
config BR2_PACKAGE_QT5QUICKCONTROLS2
	bool "qt5quickcontrols2"
	select BR2_PACKAGE_QT5DECLARATIVE
	select BR2_PACKAGE_QT5DECLARATIVE_QUICK
	depends on BR2_PACKAGE_QT5_JSCORE_AVAILABLE # qt5declarative/quick
	help
	  Qt is a cross-platform application and UI framework for
	  developers using C++.

	  This package corresponds to the qt5quickcontrols2 module.

	  http://qt.io
```

## package/qt5/qt5wayland/Config.in
```kconfig
config BR2_PACKAGE_QT5WAYLAND
	bool "qt5wayland"
	depends on BR2_PACKAGE_WAYLAND
	select BR2_PACKAGE_QT5BASE_OPENGL_ES2
	select BR2_PACKAGE_QT5DECLARATIVE
	select BR2_PACKAGE_QT5DECLARATIVE_QUICK
	help
	  Qt is a cross-platform application and UI framework for
	  developers using C++.

	  This package corresponds to the qt5wayland module.

	  http://qt.io

comment "Qt5Wayland needs wayland and ES2 as Qt5 OpenGL implementation"
	depends on !BR2_PACKAGE_WAYLAND || !BR2_PACKAGE_QT5BASE_OPENGL_ES2
```

## package/qt5/qt5webengine/Config.in
```kconfig
config BR2_PACKAGE_QT5WEBENGINE
	bool "qt5webengine"
	select BR2_PACKAGE_QT5BASE
	select BR2_PACKAGE_QT5WEBSOCKETS
	select BR2_PACKAGE_QT5WEBCHANNEL
	help
	  Qt is a cross-platform application and UI framework for
	  developers using C++.

	  This package corresponds to the qt5webengine module.

	  http://qt.io

if BR2_PACKAGE_QT5WEBENGINE

config BR2_PACKAGE_QT5WEBENGINE_PROPRIETARY_CODECS
	bool "enable proprietary codecs"
	help
	  Enable proprietary H264 and MP3 codecs for QWebkit

endif
```
